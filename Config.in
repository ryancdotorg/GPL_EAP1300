## Config.in
```kconfig
# Copyright (C) 2006-2012 OpenWrt.org
#
# This is free software, licensed under the GNU General Public License v2.
# See /LICENSE for more information.
#

mainmenu "OpenWrt Configuration"

config MODULES
	bool
	default y

config HAVE_DOT_CONFIG
	bool
	default y

config SENAOWRT_IMAGE
	bool "SENAOWRT_IMAGE"
	select PACKAGE_mactool
	default n

source "SENAO/package/senao-luci/Config.in"
source "SENAO/function_menuconfig/Config.in"

source "target/Config.in"

source "config/Config-images.in"

source "config/Config-build.in"

source "config/Config-devel.in"

source "toolchain/Config.in"

source "target/imagebuilder/Config.in"

source "target/sdk/Config.in"

source "target/toolchain/Config.in"

source "target/gpl/Config.in"

source "tmp/.config-package.in"
```

## SENAO/package/batman-adv/Config.in
```kconfig
define Package/kmod-$(PKG_NAME)/override_version
choice
    prompt "overwrite package version"
    default $(PKG_NAME)_2016.3
    depends on PACKAGE_kmod-$(PKG_NAME)

#    config $(PKG_NAME)_2013.4.0
#        bool 2013.4.0
#        help
#            $(PKG_NAME)_2013.4.0

#    config $(PKG_NAME)_2015.2
#        bool 2015.2
#        help
#            $(PKG_NAME)_2015.2

#    config $(PKG_NAME)_2016.0
#        bool 2016.0
#        help
#            $(PKG_NAME)_2016.0

    config $(PKG_NAME)_2016.3
        bool 2016.3
        help
            $(PKG_NAME)_2016.3

#    config $(PKG_NAME)_2016.5
#        bool 2016.5
#        help
#            $(PKG_NAME)_2016.5

#    config $(PKG_NAME)_2017.2
#        bool 2017.2
#        help
#            $(PKG_NAME)_2017.2

#    config $(PKG_NAME)_2018.0
#        bool 2018.0
#        help
#            $(PKG_NAME)_2018.0

    config $(PKG_NAME)_2019.3
        bool 2019.3
        help
            $(PKG_NAME)_2019.3

    config $(PKG_NAME)_2020.2
        bool 2020.2
        help
            $(PKG_NAME)_2020.2

endchoice

config KMOD_BATMAN_ADV_DEBUG_LOG
	bool "enable verbose debug logging"
	depends on PACKAGE_kmod-batman-adv
	default y

config KMOD_BATMAN_ADV_BLA
	bool "enable bridge loop avoidance"
	depends on PACKAGE_kmod-batman-adv
	default y

config KMOD_BATMAN_ADV_DAT
	bool "enable distributed arp table"
	depends on PACKAGE_kmod-batman-adv
	default y

config KMOD_BATMAN_ADV_NC
	bool "enable network coding [requires promisc mode support]"
	depends on PACKAGE_kmod-batman-adv
	default n

config KMOD_BATMAN_ADV_BATCTL
	bool "enable batctl"
	depends on PACKAGE_kmod-batman-adv
	default y
	help
	  batctl is a more intuitive managment utility for B.A.T.M.A.N.-Advanced.
	  It is an easier method for configuring batman-adv and
	  provides some additional tools for debugging as well.

config KMOD_BATMAN_ADV_BATMAN_V
	bool "enable B.A.T.M.A.N. V routing algorithm and it's only supported with Linux 3.15+"
	depends on PACKAGE_kmod-batman-adv
	default y

config SENAO_BATCTL_ICMP_COMMUNICATION
	bool "enable senao batman ping communication"
	depends on PACKAGE_kmod-batman-adv
        default n
	help
	  add info in batctl ping echo/reply packet to communication

config	SENAO_SPIN_LOCK_BH_DELAY
	bool "add delay in spin_lock_bh()"
	depends on PACKAGE_kmod-batman-adv
        default n
	help
	  add delay to void system hang when havig huge amount of soft irq
endef
```

## SENAO/package/senao-app-agent/Config.in
```kconfig
menu "APP agent related setting"
depends on PACKAGE_senao-app-agent

config APP_AGENT_SUPPORT_ENCRYPT_PAYLOAD
	bool "Encrypt payload in APP agent"
	help
	  Encrypt payload in APP agent.

config APP_AGENT_SUPPORT_USB_SETTING
	bool "USB related settings in APP agent"
	help
	  USB related settings in APP agent.

config APP_AGENT_SUPPORT_STREAM_BOOST_SETTING
	bool "Stream Boost related settings in APP agent"
	help
	  Stream Boost related settings in APP agent.

config APP_AGENT_SUPPORT_REDIRECT_DEVICE_SETTING
	bool "Redirect app agent command to target device."
	help
	  Redirect app agent command to target device.

config APP_AGENT_SUPPORT_MESH_JSON
	bool "MESH related setting in APP agent."
	depends on SUPPORT_MESH_SETTING
	help
	  MESH related setting in APP agent.

config APP_AGENT_SUPPORT_ENGENIUS
	bool "Engenius Products"
	help
	  Engenius Products.

config APP_AGENT_SUPPORT_IPCAM
	bool "Support IP Camera"
	help
	  Support IP Camera

config APP_AGENT_SUPPORT_ENCRYPT_PAYLOAD
	bool "SUPPORT ENCRYPT PAYLOAD"
	help
	  SUPPORT ENCRYPT PAYLOAD

config APP_AGENT_SUPPORT_SSL
	bool "SUPPORT SSL"
	help
	  SUPPORT SSL

config APP_AGENT_SUPPORT_WLAN_DONGLE
	bool "SUPPORT WLAN DONGLE"
	help
	  SUPPORT WLAN DONGLE

config APP_AGENT_SUPPORT_WLAN_5G_2_SETTING
	bool "Support wireless 5G - 2 band"
	depends on SUPPORT_WLAN_5G_SETTING
	help
	  SUPPORT WLAN DONGLE

config APP_AGENT_SUPPORT_AP
	bool "AP Products"
	help
	  AP Products
config APP_AGENT_SUPPORT_BATMAN_2019
	bool "Support batman 2019.3 format"
	help
	  SUPPORT BATMAN 2019
#config APP_AGENT_SUPPORT_COMMAND_LIST
#	bool "Support command list queue"
#	help
#	  Create a thread to execute external commands.

config APP_AGENT_SUPPORT_ENGENIUS_DDNS
	bool
	default y if PACKAGE_senao-ddns-update
	help
	 Support EnGenius DDNS

config APP_AGENT_SUPPORT_NAT_TRAVERSAL
	bool
	default y if PACKAGE_senao-nat-traversal
	help
		Support NAT TRAVERSAL

config APP_AGENT_SUPPORT_SYSTIME
	bool "Support SENAO systime"
	help
		Support SENAO systime

config APP_AGENT_SUPPORT_EG_AUTO_FW_CHECK
	bool "Support auto firmware upgrade of EnGenius"
	help
	   Support auto firmware upgrade of EnGenius.

config APP_AGENT_SUPPORT_LIMIT_APP_ACCOUNT_LOGIN
	bool "Support limit login account number of an APP"
	help
	  Support limit login account number of an APP

config APP_AGENT_SUPPORT_UPDATE_NODE_INFO_AT_LOGIN
	bool "Update nodes information while login"
	help
	  Update nodes information while login

config APP_AGENT_SUPPORT_WAN_AUTO_DETECTION
	bool "Auto-detect the WAN type"
	help
	  Auto-detect the WAN type

config APP_AGENT_SUPPORT_MESH_EZSETUP_FOR_AP_MODE
	bool
	default y if AP_MODE_SUPPORT_MESH_EZSETUP
	help
	  AP mode support mesh EzSetup

config APP_AGENT_SUPPORT_MESH_STATIC_ROUTE
	bool "Support mesh static route mode"
	help
	  Support mesh static route mode.
endmenu
```

## SENAO/package/senao-coova-chilli/Config.in
```kconfig
# CoovaChilli advanced configuration

menu "Configuration"
	depends on PACKAGE_senao-coova-chilli

config SENAO_COOVACHILLI_PROXY
        bool "Enable support for chilli proxy. Required for AAA Proxy through http"
        default n

config SENAO_COOVACHILLI_REDIR
	bool "Enable support for redir server. Required for uamregex"
	default n

config SENAO_COOVACHILLI_MINIPORTAL
	bool "Enable support Coova miniportal"
	default y

config SENAO_COOVACHILLI_USERAGENT
	bool "Enable recording user-agent"
	default n

config SENAO_COOVACHILLI_DNSLOG
	bool "Enable support to log DNS name queries"
	default n

config SENAO_COOVACHILLI_UAMDOMAINFILE
	bool "Enable loading of mass uamdomains from file"
	default n

config SENAO_COOVACHILLI_EAPOL
	bool "Enable eapol"
	default n

config SENAO_COOVACHILLI_LARGELIMITS
	bool "Enable larger limits for use with non-embedded systems"
	default y

config SENAO_COOVACHILLI_NFQUEUE
	bool "Netfilter queue"
	depends on PACKAGE_kmod-ipt-nfcoova
	default n

config SENAO_COOVACHILLI_REDIRDNSREQ
	bool "support REDIRDNSREQ"
	default n

choice
	prompt "SSL library"
	default SENAO_COOVACHILLI_OPENSSL

config SENAO_COOVACHILLI_NOSSL
	bool "No SSL support"

config SENAO_COOVACHILLI_MATRIXSSL
	bool "MatrixSSL"

config SENAO_COOVACHILLI_CYASSL
	bool "CyaSSL"

config SENAO_COOVACHILLI_OPENSSL
	bool "OpenSSL"

endchoice

config SENAO_COOVACHILLI_SESSGARDEN
	bool "Session wallgarden"

config SENAO_COOVACHILLI_INSPECT
	bool "Enable inspect"
	default y

endmenu
```

## SENAO/package/senao-openapi-server/Config.in
```kconfig
menu "SENAO Openapi Server related setting"
depends on PACKAGE_senao-openapi-server

config SENAO_OPENAPI_SERVER_SUPPORT_APP_INTERFACE
	bool "Support app interface"
	help
	  Support app interface.
endmenu
```

## SENAO/package/senao-syseye/Config.in
```kconfig
# SYSEYE ACT LINKCHECK advanced configuration

menu "Configuration"

config PACKAGE_syseye-use-fork
        bool "usefork"
        default n

endmenu 
```

## SENAO/package/senao_capwap_c1.9.x/Config.in
```kconfig
menu "CAPWAP related setting"
	depends on PACKAGE_senao_capwap_c1.9.x

config SUPPORT_CAPTIVE_PORTAL_SETTING
	bool "Support Captive Portal in CAPWAP"
	default y
	help
	  Support Captive Portal in CAPWAP.

config SUPPORT_CAPWAP_NO_BACKGROUND_SCAN
	bool "Not Support Background Scan in CAPWAP"
	default n
	help
	  Not Support Background Scan in CAPWAP.

endmenu
```

## package/boot/uboot-infinity6/Config.in
```kconfig
define Package/uboot-sstar-infinity6/config
if PACKAGE_uboot-sstar-infinity6
choice
    prompt "Flash Type"
    config PACKAGE_$(PKG_NAME)-SENAO_SPINAND
        bool "SPI NAND"

    config PACKAGE_$(PKG_NAME)-SENAO_SPINOR
        bool "SPI NOR"

endchoice

menu "Senao definitions"
config PACKAGE_$(PKG_NAME)-SENAO_RECOVERY_MODE
    bool "Use recovery mode"
    default y
    depends on PACKAGE_uboot-sstar-infinity6

config PACKAGE_$(PKG_NAME)-SENAO_RECOVERY_MODE_DISABLE_WAN
    bool "disable wan"
    default n
    depends on PACKAGE_uboot-sstar-infinity6-SENAO_RECOVERY_MODE

config PACKAGE_$(PKG_NAME)-SENAO_IMAGE_CAPWAP_HEADER
    bool "Image header support capwap"
    default n
    depends on PACKAGE_uboot-sstar-infinity6-SENAO_RECOVERY_MODE

config PACKAGE_$(PKG_NAME)-SENAO_HAS_OPERATION_SELECTION
    bool "Use Operation Selection Menu"
    default y
    depends on PACKAGE_uboot-sstar-infinity6

config PACKAGE_$(PKG_NAME)-SENAO_HAS_RMGMT
    bool "RMGMT Support"
    default "n"
	depends on PACKAGE_uboot-sstar-infinity6

config PACKAGE_$(PKG_NAME)-SENAO_HAS_RMGMT_DBG
    bool "RMGMT Debug Support"
    default "n"
	depends on PACKAGE_uboot-sstar-infinity6-SENAO_HAS_RMGMT

config PACKAGE_$(PKG_NAME)-MAKEOPTS_SENAO_RMGMT_LED1
    string "RMGMT LED 1"
    default "POWER1_LED"
    depends on PACKAGE_uboot-sstar-infinity6-SENAO_HAS_RMGMT

config PACKAGE_$(PKG_NAME)-MAKEOPTS_SENAO_RMGMT_LED2
    string "RMGMT LED 2"
    default "WLAN_2G_LED"
    depends on PACKAGE_uboot-sstar-infinity6-SENAO_HAS_RMGMT

config PACKAGE_$(PKG_NAME)-SENAO_GPIO_TEST
    bool "gpio test"
    default n
    depends on PACKAGE_uboot-sstar-infinity6

config PACKAGE_$(PKG_NAME)-SENAO_GPIO_BUTTON_TESTING
    bool "Button gpio test"
    default n
    depends on PACKAGE_uboot-sstar-infinity6

config PACKAGE_$(PKG_NAME)-SENAO_GPIO_LED_TESTING
    bool "LED gpio test"
    default n
    depends on PACKAGE_uboot-sstar-infinity6

config PACKAGE_$(PKG_NAME)-SENAO_LED_INIT
    bool "LED init"
    default n
    depends on PACKAGE_uboot-sstar-infinity6

config PACKAGE_$(PKG_NAME)-SENAO_I2C_REGULATORS_TESTING
    bool "i2c Regulators moduel test"
    default n
    depends on PACKAGE_uboot-sstar-infinity6

config PACKAGE_$(PKG_NAME)-SENAO_PSE_DETECT_MODE
    bool "pse detect mode feature"
    default n
    depends on PACKAGE_uboot-sstar-infinity6

endmenu

menu "Senao configurations"
comment ""
comment "leave it blank for undefined variable"
comment ""
config PACKAGE_$(PKG_NAME)-UBOOT_CONFIG_TARGET
    string "U-Boot config target"
    default "infinity6"
    depends on PACKAGE_uboot-sstar-infinity6

config PACKAGE_$(PKG_NAME)-MAKEOPTS_SENAO_MODEL_NAME
    string "Senao model name"
    default "SAV528"
    depends on PACKAGE_uboot-sstar-infinity6

config PACKAGE_$(PKG_NAME)-MAKEOPTS_SENAO_UBOOT_VERSION
    string "U-Boot Version"
    default "1.0.0"
    depends on PACKAGE_uboot-sstar-infinity6

config PACKAGE_$(PKG_NAME)-MAKEOPTS_CONFIG_IPADDR
    string "device ip"
    default "192.168.1.1"
    depends on PACKAGE_uboot-sstar-infinity6

config PACKAGE_$(PKG_NAME)-MAKEOPTS_CONFIG_SERVERIP
    string "server ip"
    default "192.168.1.10"
    depends on PACKAGE_uboot-sstar-infinity6

config PACKAGE_$(PKG_NAME)-MAKEOPTS_CONFIG_ETHADDR
    string "ethernet address"
    default "00:aa:bb:cc:dd:10"
    depends on PACKAGE_uboot-sstar-infinity6

config PACKAGE_$(PKG_NAME)-MAKEOPTS_SENAO_SN
    string "Serial number"
    default "000000001"
    depends on PACKAGE_uboot-sstar-infinity6

config PACKAGE_$(PKG_NAME)-MAKEOPTS_SENAO_HW_VER
    string "Hardware version"
    default "0.0.1"
    depends on PACKAGE_uboot-sstar-infinity6

config PACKAGE_$(PKG_NAME)-MAKEOPTS_SENAO_PRO_ID
    string "CONFIG_PRO_ID"
    default "000"
    depends on PACKAGE_uboot-sstar-infinity6

config PACKAGE_$(PKG_NAME)-MAKEOPTS_SENAO_COUNTRY
    string "Country code"
    default "000"
    depends on PACKAGE_uboot-sstar-infinity6

config PACKAGE_$(PKG_NAME)-MAKEOPTS_SENAO_DOMAIN
    string "CONFIG_DOMAIN"
    default "0"
    depends on PACKAGE_uboot-sstar-infinity6

config PACKAGE_$(PKG_NAME)-MAKEOPTS_SENAO_OP_MODE
    string "opmode"
    default "0"
    depends on PACKAGE_uboot-sstar-infinity6

config PACKAGE_$(PKG_NAME)-MAKEOPTS_SENAO_WANADDR
    string "Wan macaddr"
    default "00:aa:bb:cc:dd:11"
    depends on PACKAGE_uboot-sstar-infinity6

config PACKAGE_$(PKG_NAME)-MAKEOPTS_SENAO_WLANADDR
    string "Wan macaddr"
    default "00:aa:bb:cc:dd:12"
    depends on PACKAGE_uboot-sstar-infinity6

config PACKAGE_$(PKG_NAME)-MAKEOPTS_SENAO_HW_ID
    string "Hardware ID"
    default "00000000"
    depends on PACKAGE_uboot-sstar-infinity6

config PACKAGE_$(PKG_NAME)-MAKEOPTS_SENAO_DEBUG
    string "Debug"
    default "0"
    depends on PACKAGE_uboot-sstar-infinity6

config PACKAGE_$(PKG_NAME)-MAKEOPTS_SENAO_FWADDR
    string "Firmware macaddr"
    default "00:aa:bb:cc:dd:14"
    depends on PACKAGE_uboot-sstar-infinity6

config PACKAGE_$(PKG_NAME)-MAKEOPTS_SENAO_ATHADDR
    string "ATH macaddr"
    default "00:aa:bb:cc:dd:13"
    depends on PACKAGE_uboot-sstar-infinity6

config PACKAGE_$(PKG_NAME)-MAKEOPTS_SENAO_APP_PART
    string "Apps partition"
    default "0"
    depends on PACKAGE_uboot-sstar-infinity6

config PACKAGE_$(PKG_NAME)-MAKEOPTS_SENAO_OLED_ON
    string "OLED_ON"
    default "0"
    depends on PACKAGE_uboot-sstar-infinity6

config PACKAGE_$(PKG_NAME)-MAKEOPTS_SENAO_DDWRT_SW
    string "CONFIG_DDWRT_SW"
    default "0"
    depends on PACKAGE_uboot-sstar-infinity6

config PACKAGE_$(PKG_NAME)-MAKEOPTS_SENAO_SN_EXTRA
    string "CONFIG_SN_EXTRA"
    default "00000000000000000000"
    depends on PACKAGE_uboot-sstar-infinity6

config PACKAGE_$(PKG_NAME)-MAKEOPTS_SENAO_LANGUAGE_CODE
    string "LANGUAGE_CODE"
    default "00"
    depends on PACKAGE_uboot-sstar-infinity6

config PACKAGE_$(PKG_NAME)-MAKEOPTS_SENAO_SERVICE_TAG
    string "CONFIG_SERVICE_TAG"
    default "000000000000000"
    depends on PACKAGE_uboot-sstar-infinity6

config PACKAGE_$(PKG_NAME)-MAKEOPTS_SENAO_BUNDLE_AP_MAC
    string "CONFIG_BUNDLE_AP_MAC"
    default "00:aa:bb:cc:dd:15"
    depends on PACKAGE_uboot-sstar-infinity6

config PACKAGE_$(PKG_NAME)-MAKEOPTS_SENAO_PRODUCT_FILENAME
    string "firmware product name"
    default ""
    depends on PACKAGE_uboot-sstar-infinity6

config PACKAGE_$(PKG_NAME)-MAKEOPTS_SENAO_MTDPARTS
    string "mtdparts for spinand"
    default "mtdparts=nand0:0x20000@0x60000(IPL0),0x20000(IPL1),0x20000(IPL2),0x20000(IPL_CUST0),0x20000(IPL_CUST1),0x20000(IPL_CUST2),0x60000(UBOOT0),0x60000(UBOOT1),0x20000(ENV),-(rootfs)"
    depends on PACKAGE_$(PKG_NAME)-SENAO_SPINAND

config PACKAGE_$(PKG_NAME)-MAKEOPTS_SENAO_BOOTCOMMAND
    string "bootcmd for spinand"
    default "ubi part rootfs; ubi read 0x22000000 kernel; bootm 0x22000000"
    depends on PACKAGE_$(PKG_NAME)-SENAO_SPINAND
endmenu

endif
endef
```
